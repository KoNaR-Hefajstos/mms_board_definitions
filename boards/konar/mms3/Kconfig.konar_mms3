## boards/konar/mms3/Kconfig.konar_mms3
```kconfig
config BOARD_KONAR_MMS3
	select SOC_STM32F405XX if BOARD_KONAR_MMS3_STM32F405XX
	select SOC_ESP32C6 if BOARD_KONAR_MMS3_ESP32C6_HPCORE || BOARD_KONAR_MMS3_ESP32C6_LPCORE
	select SOC_ESP32C6_HPCORE if BOARD_KONAR_MMS3_ESP32C6_HPCORE
	select SOC_ESP32C6_LPCORE if BOARD_KONAR_MMS3_ESP32C6_LPCORE
```

## boards/konar/mms3/board.yml
```yaml
board:
  name: "konar_mms3"
  full_name: Mini-Moducard-System-3
  vendor: konar
  socs:
    - name: stm32f405xx
```

## boards/konar/mms3/konar_mms3_esp32c6_hpcore_defconfig
```kconfig
# Serial & Console
CONFIG_SERIAL=y
CONFIG_CONSOLE=y
CONFIG_UART_CONSOLE=y
CONFIG_HEAP_MEM_POOL_SIZE=98304
# Pin Control
CONFIG_PINCTRL=y
CONFIG_GPIO=y
CONFIG_I2C=y
CONFIG_SPI=y
```

## boards/konar/mms3/konar_mms3_stm32f405xx_defconfig
```kconfig
# Hardware Clock Setup
CONFIG_CLOCK_CONTROL=y
CONFIG_SYS_CLOCK_HW_CYCLES_PER_SEC=168000000

# Serial & Console
CONFIG_SERIAL=y
CONFIG_CONSOLE=y
CONFIG_UART_CONSOLE=y

# Pin Control
CONFIG_PINCTRL=y
CONFIG_GPIO=y
CONFIG_I2C=y
CONFIG_SPI=y
CONFIG_USB_DEVICE_STACK_NEXT=y
CONFIG_CDC_ACM_SERIAL_INITIALIZE_AT_BOOT=y
CONFIG_USBD_CDC_ACM_LOG_LEVEL_OFF=y
CONFIG_UART_LINE_CTRL=y
```
